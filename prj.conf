## CMakeLists.txt
```
#
# Copyright (c) 2023 Nordic Semiconductor
#
# SPDX-License-Identifier: LicenseRef-Nordic-5-Clause
#
cmake_minimum_required(VERSION 3.20.0)

# Configure VERSION from repository branch and tag
find_package(Git)

if(GIT_EXECUTABLE)
  execute_process(
    COMMAND ${GIT_EXECUTABLE} branch --show-current
    WORKING_DIRECTORY ${CMAKE_SOURCE_DIR}
    OUTPUT_VARIABLE GIT_BRANCH
    )
  execute_process(
    COMMAND ${GIT_EXECUTABLE} describe --dirty --tags --long --match [0-9]*.[0-9]*.[0-9]*
    WORKING_DIRECTORY ${CMAKE_SOURCE_DIR}
    OUTPUT_VARIABLE GIT_VERSION
    )
endif()

if(GIT_BRANCH STREQUAL "")
  set(GIT_BRANCH unknown)
  message(WARNING "Unknown Git Branch")
endif()

if(GIT_VERSION STREQUAL "")
  set(GIT_VERSION 0.0.0-0)
  message(WARNING "Unknown Tag/Version")
endif()

string(STRIP ${GIT_BRANCH} GIT_BRANCH)
string(STRIP ${GIT_VERSION} GIT_VERSION)
string(REPLACE "-" ";" GIT_VERSION ${GIT_VERSION})
list(GET GIT_VERSION 0 GIT_RELEASE)
list(GET GIT_VERSION 1 GIT_TWEAK)
string(REPLACE "v" "" GIT_RELEASE ${GIT_RELEASE})
string(REPLACE "." ";" GIT_RELEASE ${GIT_RELEASE})
list(GET GIT_RELEASE 0 GIT_MAJOR)
list(GET GIT_RELEASE 1 GIT_MINOR)
list(GET GIT_RELEASE 2 GIT_PATCH)

configure_file(${CMAKE_SOURCE_DIR}/VERSION_SRC ${CMAKE_SOURCE_DIR}/VERSION @ONLY)

# Zephyr
find_package(Zephyr REQUIRED HINTS $ENV{ZEPHYR_BASE})
project(NONE)

# NORDIC SDK APP START
FILE(GLOB_RECURSE app_sources src/*.c)
target_sources(app PRIVATE ${app_sources})

# NORDIC SDK APP END

FILE(GLOB_RECURSE files vqf-c/src/*.c)
target_sources(app PRIVATE ${files})

target_include_directories(app PRIVATE src)

# riftcv1: fast ramp-up needs a fix in ESB's PTX interrupt, so NCS's
# subsys/esb/esb.c is swapped for the patched copy in esb/
set(ESB_LIB ..__nrf__subsys__esb)
get_target_property(esb_sources ${ESB_LIB} SOURCES)
list(FILTER esb_sources EXCLUDE REGEX "(^|/)esb\\.c$")
set_property(TARGET ${ESB_LIB} PROPERTY SOURCES ${esb_sources} ${CMAKE_CURRENT_SOURCE_DIR}/esb/esb.c)
target_include_directories(${ESB_LIB} PRIVATE ${ZEPHYR_NRF_MODULE_DIR}/subsys/esb)
target_include_directories(app PRIVATE vqf-c/src)

# Force recompile for updated build timestamp
add_custom_target(touch_util_h ALL
    COMMAND ${CMAKE_COMMAND} -E touch ${CMAKE_SOURCE_DIR}/src/build_defines.h
)
```

## Kconfig
```
#
# Copyright (c) 2023 Nordic Semiconductor
#
# SPDX-License-Identifier: LicenseRef-Nordic-5-Clause
#

config USE_SLIMENRF_CONSOLE
    bool "Use basic console"
    default y
    help
        Use basic console for commands.

config RIFT_FAST_RAMP_UP
    bool "ESB fast radio ramp-up"
    default y
    help
      40 us radio ramp-ups in place of about 130 us, for the band packet
      timing plan's sub-slots. The receiver has to be built the same way.

config BATTERY_CHARGER_HAS_NTC
    bool "Battery thermistor"
    help
      Flag for battery NTC thermistor availability.

choice
    prompt "Battery voltage mapping"
    default BATTERY_NO_MAPPING

config BATTERY_USE_REG_BUCK_MAPPING
    bool "Use buck regulator mapping (3.7V battery, DCDC)"
    help
      Use a constant power mapping for battery voltage.
      Preffered for systems with a buck regulator.
      Measured at a system voltage of 3.0V.

config BATTERY_USE_REG_LDO_MAPPING
    bool "Use LDO linear regulator mapping (3.7V battery, LDO)"
    help
      Use a constant current mapping for battery voltage.
      Preferred for systems with a linear regulator.

config BATTERY_NO_MAPPING
    bool "Disable battery voltage mapping"
    help
      Always map to 100% battery. Disables battery monitoring.

endchoice

config BATTERY_LOW_RUNTIME_THRESHOLD
    int "Low battery runtime threshold (ms)"
    default 10800000
    help
      Trigger low battery when estimated runtime falls below threshold.
      If estimated runtime is not available, low battery will trigger under 10% estimated state of charge.

choice
    prompt "Status LED color mapping"
    default LED_TRI_COLOR

config LED_RGB_COLOR
    bool "Use RGB color mapping"
    help
        Use RGB or RG color mapping for LED status if available.

config LED_TRI_COLOR
    bool "Use default color mapping"
    help
        Use the default color mapping for LED status.

endchoice

menu "Status LED default status color"
    depends on LED_RGB_COLOR

config LED_DEFAULT_COLOR_R
    int "Red value"
    range 0 10000
    default 4000
    depends on LED_RGB_COLOR
    help
        Red color for default status.
        Valid range is 0 to 10000.

config LED_DEFAULT_COLOR_G
    int "Green value"
    range 0 10000
    default 6000
    depends on LED_RGB_COLOR
    help
        Green color for default status.
        Valid range is 0 to 10000.

config LED_DEFAULT_COLOR_B
    int "Blue value"
    range 0 10000
    default 0
    depends on LED_RGB_COLOR
    help
        Blue color for default status.
        Valid range is 0 to 10000.

endmenu

config USER_EXTRA_ACTIONS
    bool "Multiple press actions"
    help
        Allow user to use multiple presses to calibrate, pair, or enter DFU.
        By default, pairing is available when holding down sw0 for 5 seconds.
        By default, DFU is available when holding down sw0 and plugging in a USB cable.

config IGNORE_RESET
    bool "Ignore reset"
    default y
    help
        If sw0 is available, don't perform any extra actions on reset.

config USER_SHUTDOWN
    bool "User shutdown support"
    default y
    help
        Allow user to use reset or sw0 to shutdown.

config USE_IMU_WAKE_UP
    bool "IMU wake up support"
    default y
    help
        Use IMU wake up state if IMU wake up is present.

config DELAY_SLEEP_ON_STATUS
    bool "Delay IMU wake up mode on status flags"
    default y
    depends on USE_IMU_WAKE_UP
    help
        Delay IMU wake up state if there is an active status flag or in pairing mode.

config WOM_USE_DCDC
    bool "Use DCDC in IMU wake up mode"
    depends on USE_IMU_WAKE_UP
    help
        Use DCDC instead of LDO in IMU wake up state if it is more efficient.

config CONNECTION_TIMEOUT_DELAY
    int "Connection timeout delay (ms)"
    default 300000
    depends on USER_SHUTDOWN
    help
        Connection timeout duration when receiver is not detected.

choice
    prompt "Sensor rotation"
    default SENSOR_ROTATION_90

config SENSOR_ROTATION_0
    bool "0 degrees"

config SENSOR_ROTATION_90
    bool "90 degrees"

config SENSOR_ROTATION_180
    bool "180 degrees"

config SENSOR_ROTATION_270
    bool "270 degrees"

config SENSOR_ROTATION_0_FLIPPED
    bool "0 degrees flipped"

config SENSOR_ROTATION_90_FLIPPED
    bool "90 degrees flipped"

config SENSOR_ROTATION_180_FLIPPED
    bool "180 degrees flipped"

config SENSOR_ROTATION_270_FLIPPED
    bool "270 degrees flipped"

endchoice

menu "Sensor power saving"

config SENSOR_LP_TIMEOUT
    int "Sensor low power delay (ms)"
    default 500
    help
        Low power timeout during no motion.

config SENSOR_USE_LOW_POWER_2
    bool "Use additional low power modes"
    help
        Use a higher latency sensor mode during no motion.

config USE_IMU_TIMEOUT
    bool "Use IMU wake up state"
    default y
    depends on USE_IMU_WAKE_UP
    help
        Use IMU wake up state during no motion.

config IMU_TIMEOUT_RAMP_MIN
    int "Sensor timeout minimum delay (ms)"
    default 5000
    depends on USE_IMU_TIMEOUT || SENSOR_USE_LOW_POWER_2
    help
        Minimum timeout during no motion. Initial period on wake up.

config IMU_TIMEOUT_RAMP_MAX
    int "Sensor timeout maximum delay (ms)"
    default 15000
    depends on USE_IMU_TIMEOUT || SENSOR_USE_LOW_POWER_2
    help
        Maximum timeout during no motion.

config USE_ACTIVE_TIMEOUT
    bool "Use activity timeout"
    default y
    depends on USE_IMU_WAKE_UP || USER_SHUTDOWN
    help
        Delay IMU wake up state or user shutdown during activity.

choice
    prompt "Activity timeout mode"
    default SLEEP_ON_ACTIVE_TIMEOUT
    depends on USE_ACTIVE_TIMEOUT

config SLEEP_ON_ACTIVE_TIMEOUT
    bool "IMU wake up"
    depends on USE_IMU_WAKE_UP
    help
        Use IMU wake up state when activity timeout elapses.

config SHUTDOWN_ON_ACTIVE_TIMEOUT
    bool "User shutdown"
    depends on USER_SHUTDOWN
    help
        Use user shutdown when activity timeout elapses.

endchoice

config ACTIVE_TIMEOUT_THRESHOLD
    int "Activity timeout threshold (ms)"
    default 15000
    depends on USE_ACTIVE_TIMEOUT
    help
        Trigger activity timeout after a certain threshold of activity.

config ACTIVE_TIMEOUT_DELAY
    int "Activity timeout delay (ms)"
    default 900000
    depends on USE_ACTIVE_TIMEOUT
    help
        Activity timeout duration when triggered.

endmenu

config SENSOR_ACCEL_ODR
    int "Accelerometer output data rate (Hz)"
    default 100
    help
        Requested accelerometer output data rate. Actual rate will be raised to the nearest supported rate.
        A higher rate will increase the time to read and process sensor data.

config SENSOR_GYRO_ODR
    int "Gyrometer output data rate (Hz)"
    default 200
    help
        Requested gyrometer output data rate. Actual rate will be raised to the nearest supported rate.
        A higher rate will increase the time to read and process sensor data.
        A lower rate is recommended for IMUs with poor gyrometer rate noise density. (e.g. BMI270, LSM6DS3TR-C)

config SENSOR_ACCEL_FS
    int "Accelerometer full scale (g)"
    default 4
    help
        Requested accelerometer full scale. Actual scale will be raised to the nearest supported scale.
        A lower scale may improve noise performance, but is more likely to saturate.

config SENSOR_GYRO_FS
    int "Gyrometer full scale (dps)"
    default 1000
    help
        Requested gyrometer full scale. Actual scale will be raised to the nearest supported scale.
        A lower scale may improve noise performance, but is more likely to saturate.

config SENSOR_USE_MAG
    bool "Magnetometer support"
    default y
    help
        Use magnetometer if it is present.

config USE_SENSOR_CLOCK
    bool "Use external IMU clock"
    default y
    help
        Use external IMU clock if it is present.

choice
    prompt "Sensor fusion"
    default SENSOR_USE_VQF
    help
        Select the sensor fusion method.

config SENSOR_USE_VQF
    bool "Use VQF"
    help
        Use VQF for sensor fusion.
        Based on Kalman filter.

endchoice

config SENSOR_USE_6_SIDE_CALIBRATION
    bool "Use 6-side calibration"
    default y
    depends on USE_SLIMENRF_CONSOLE
    help
        Use 6-side calibration for accelerometer.
        Calibration can be completed through the basic console.

config RADIO_TX_POWER
    int "Radio output power (dBm)"
    default 8
    help
        Radio output power level.
        A lower value may reduce power consumption.

config CONNECTION_OVER_HID
    bool "Use HID for data output"
    help
        Use HID if available.
        Otherwise, use ESB only.

source "Kconfig.zephyr"
```

## prj.conf
```kconfig
#CONFIG_NCS_SAMPLES_DEFAULTS
CONFIG_ASSERT=y
CONFIG_ASSERT_NO_COND_INFO=y
CONFIG_ASSERT_NO_MSG_INFO=y
CONFIG_RESET_ON_FATAL_ERROR=y

CONFIG_NCS_APPLICATION_BOOT_BANNER_STRING="SlimeVR-Tracker-nRF"
#CONFIG_NCS_BOOT_BANNER=n
CONFIG_BOOT_BANNER=n

CONFIG_ESB=y
#need to enable for nRF54L
#CONFIG_NRFX_DPPI10=y

CONFIG_ADC=y
CONFIG_ADC_NRFX_SAADC=y
CONFIG_FPU=y
CONFIG_I2C=y
CONFIG_SPI=y
CONFIG_PINCTRL=y
CONFIG_SENSOR=y

CONFIG_CMSIS_DSP=y
CONFIG_CMSIS_DSP_BASICMATH=y
CONFIG_CMSIS_DSP_CONTROLLER=y
CONFIG_CMSIS_DSP_FASTMATH=y
CONFIG_CMSIS_DSP_SUPPORT=y

CONFIG_NVS=y
CONFIG_NVS_LOOKUP_CACHE=y
CONFIG_NVS_INIT_BAD_MEMORY_REGION=y

CONFIG_POWEROFF=y
CONFIG_REBOOT=y

CONFIG_FLASH=y
CONFIG_FLASH_PAGE_LAYOUT=y
CONFIG_FLASH_MAP=y

CONFIG_SETTINGS=y
CONFIG_SETTINGS_RUNTIME=y
CONFIG_SETTINGS_NONE=y

CONFIG_MPU_ALLOW_FLASH_WRITE=y

CONFIG_RETAINED_MEM=y

CONFIG_USE_SEGGER_RTT=y
CONFIG_LOG=y
#CONFIG_PRINTK=y
CONFIG_LOG_MODE_DEFERRED=y
CONFIG_LOG_SPEED=y
CONFIG_LOG_BACKEND_RTT=y
CONFIG_CBPRINTF_FP_SUPPORT=y
CONFIG_ADC_LOG_LEVEL_OFF=y
CONFIG_LOG_FUNC_NAME_PREFIX_ERR=y
CONFIG_LOG_BUFFER_SIZE=1536
CONFIG_LOG_BACKEND_UART_AUTOSTART=n
CONFIG_LOG_PROCESS_THREAD_SLEEP_MS=50
CONFIG_LOG_PROCESS_THREAD_STACK_SIZE=1024

CONFIG_PWM=y
CONFIG_GPIO=y

CONFIG_CRC=y

CONFIG_NEWLIB_LIBC=y
#deprecated?
#CONFIG_NRFX_TIMER1=y

#speed up boot? (use internal rc oscillator)
CONFIG_CLOCK_CONTROL_NRF_K32SRC_RC=y
CONFIG_CLOCK_CONTROL_NRF_K32SRC_RC_CALIBRATION=n
#speed up boot? (synthesize lf clock)
#CONFIG_CLOCK_CONTROL_NRF_K32SRC_SYNTH=y

# dont need it
CONFIG_CRYPTO=n

# set timeout for 25ms, sufficient for ~1000 bytes
CONFIG_I2C_NRFX_TRANSFER_TIMEOUT=25

CONFIG_USB_DEVICE_HID=y
CONFIG_USB_DEVICE_VID=0x1209
CONFIG_USB_DEVICE_PID=0x7692
CONFIG_USB_HID_BOOT_PROTOCOL=y
CONFIG_USB_DEVICE_INITIALIZE_AT_BOOT=n
CONFIG_USB_CDC_ACM=y
CONFIG_UART_INTERRUPT_DRIVEN=y
CONFIG_USB_WORKQUEUE_STACK_SIZE=512

CONFIG_SERIAL=y
CONFIG_CONSOLE=y
CONFIG_RTT_CONSOLE=y
CONFIG_UART_CONSOLE=y
CONFIG_UART_LINE_CTRL=y
# fit "write all <base64:173>"
CONFIG_CONSOLE_INPUT_MAX_LINE_LEN=256

CONFIG_LOG=y
CONFIG_USB_DRIVER_LOG_LEVEL_ERR=y
CONFIG_USB_DEVICE_LOG_LEVEL_ERR=y
CONFIG_USB_CDC_ACM_LOG_LEVEL_OFF=y

CONFIG_LOG_BACKEND_UART=y

CONFIG_CONSOLE_SUBSYS=y
CONFIG_CONSOLE_GETLINE=y

CONFIG_NVS_LOG_LEVEL_WRN=y
CONFIG_USB_HID_LOG_LEVEL_WRN=y

CONFIG_USB_DEVICE_SOF=y
CONFIG_USB_HID_REPORTS=256

#CONFIG_USB_HID_POLL_INTERVAL_MS=1
CONFIG_USB_HID_POLL_INTERVAL_MS=0
CONFIG_HID_INTERRUPT_EP_MPS=64
#CONFIG_ENABLE_HID_INT_OUT_EP=y

CONFIG_SYSTEM_WORKQUEUE_STACK_SIZE=256
CONFIG_MAIN_STACK_SIZE=512
#crashing on nrf54l at 512

CONFIG_THREAD_NAME=y

CONFIG_HEAP_MEM_POOL_SIZE=2048
CONFIG_ISR_STACK_SIZE=1024

CONFIG_PM_DEVICE=y

CONFIG_BASE64=y

#CONFIG_THREAD_ANALYZER=y
#CONFIG_THREAD_ANALYZER_AUTO=y
#CONFIG_THREAD_ANALYZER_AUTO_INTERVAL=5

#about 20KB saved
#CONFIG_LTO=y
#CONFIG_ISR_TABLES_LOCAL_DECLARATION=y

# riftcv1: ESB's radio interrupt above the default peripheral priority (1), so its
# handler always runs within the 40 us of a fast ramp-up (RIFT_FAST_RAMP_UP)
CONFIG_ESB_RADIO_IRQ_PRIORITY=0
```

## boards/xiao_ble_nrf52840_sense.conf
```kconfig
CONFIG_USB_DEVICE_STACK=y
CONFIG_USB_DEVICE_MANUFACTURER="Seeed Studio"
CONFIG_USB_DEVICE_PRODUCT="SlimeNRF Tracker XIAO Sense"

CONFIG_BATTERY_USE_REG_LDO_MAPPING=y
CONFIG_LED_RGB_COLOR=y

# riftcv1-band: rift_imu's 36-byte frame packets, and the IMU near the design's 1 kHz
CONFIG_ESB_MAX_PAYLOAD_LENGTH=40
CONFIG_SENSOR_GYRO_ODR=833
CONFIG_SENSOR_ACCEL_ODR=833

# riftcv1-band: no low-power reads (33 ms apart) when still, no IMU wake-up state and no
# activity timeout (15 minutes still sent the band to sleep): the band powers off by its button
CONFIG_SENSOR_LP_TIMEOUT=2000000000
CONFIG_USE_IMU_TIMEOUT=n
CONFIG_USE_ACTIVE_TIMEOUT=n
```

## src/console.c
```c
#include "globals.h"
#include "system/system.h"
#include "system/battery_tracker.h"
#include "sensor/sensor.h"
#include "sensor/calibration.h"
#include "connection/esb.h"
#include "connection/rift_ts.h"
#include "connection/rift_pulse.h"
#include "connection/rift_imu.h"
#include "connection/rift_airtime.h"
#include "build_defines.h"
#include "parse_args.h"

#if CONFIG_USB_DEVICE_STACK
#define USB DT_NODELABEL(usbd)
#define USB_EXISTS (DT_NODE_HAS_STATUS(USB, okay) && CONFIG_UART_CONSOLE)
#endif

#if (USB_EXISTS || CONFIG_RTT_CONSOLE) && CONFIG_USE_SLIMENRF_CONSOLE

#if USB_EXISTS
#include <zephyr/console/console.h>
#include <zephyr/logging/log_ctrl.h>
#else
#include "system/rtt_console.h"
#endif
#include <zephyr/drivers/gpio.h>
#include <zephyr/sys/reboot.h>
#include <zephyr/sys/base64.h>

#include <ctype.h>

LOG_MODULE_REGISTER(console, LOG_LEVEL_INF);

static void console_thread(void);
#if USB_EXISTS
static struct k_thread console_thread_id;
static K_THREAD_STACK_DEFINE(console_thread_id_stack, 1024); // TODO: larger stack size to handle print info
#else
K_THREAD_DEFINE(console_thread_id, 1024, console_thread, NULL, NULL, NULL, CONSOLE_THREAD_PRIORITY, 0, 0);
#endif

#define DFU_EXISTS CONFIG_BUILD_OUTPUT_UF2 || CONFIG_BOARD_HAS_NRF5_BOOTLOADER
#define ADAFRUIT_BOOTLOADER CONFIG_BUILD_OUTPUT_UF2
#define NRF5_BOOTLOADER CONFIG_BOARD_HAS_NRF5_BOOTLOADER

#if NRF5_BOOTLOADER
static const struct device *gpio_dev = DEVICE_DT_GET(DT_NODELABEL(gpio0));
#endif

static const char *meows[] = {
	"Mew",
	"Meww",
	"Meow",
	"Meow meow",
	"Mrrrp",
	"Mrrf",
	"Mreow",
	"Mrrrow",
	"Mrrr",
	"Purr",
	"mew",
	"meww",
	"meow",
	"meow meow",
	"mrrrp",
	"mrrf",
	"mreow",
	"mrrrow",
	"mrrr",
	"purr",
};

static const char *meow_punctuations[] = {
	".",
	"?",
	"!",
	"-",
	"~",
	""
};

static const char *meow_suffixes[] = {
	" :3",
	" :3c",
	" ;3",
	" ;3c",
	" x3",
	" x3c",
	" X3",
	" X3c",
	" >:3",
	" >:3c",
	" >;3",
	" >;3c",
	""
};

static uint8_t meow_colors[] = {
	212,
	176,
	177
};

void console_thread_create(void)
{
#if USB_EXISTS
	k_thread_create(&console_thread_id, console_thread_id_stack, K_THREAD_STACK_SIZEOF(console_thread_id_stack), (k_thread_entry_t)console_thread, NULL, NULL, NULL, CONSOLE_THREAD_PRIORITY, 0, K_NO_WAIT);
#endif
}

void console_thread_abort(void)
{
#if USB_EXISTS
	k_thread_abort(&console_thread_id);
#endif
}

static void print_board(void)
{
#if USB_EXISTS
	printk(CONFIG_USB_DEVICE_MANUFACTURER " " CONFIG_USB_DEVICE_PRODUCT "\n");
#endif
	printk(FW_STRING);
    printk("Commit: " TOSTRING(APP_BUILD_VERSION) "\n");
    printk("Build: %d-%02d-%02d %02d:%02d:%02d\n", BUILD_YEAR, BUILD_MONTH, BUILD_DAY, BUILD_HOUR, BUILD_MIN, BUILD_SEC);

	printk("\nBoard: " CONFIG_BOARD "\n");
	printk("SOC: " CONFIG_SOC "\n");
	printk("Target: " CONFIG_BOARD_TARGET "\n");
}

static void print_sensor(void)
{
	printk("IMU: %s\n", (retained->imu_addr & 0x7F) != 0x7F ? sensor_get_sensor_imu_name() : "Not searching");
	if (retained->imu_reg != 0xFF)
		printk("Interface: %s\n", (retained->imu_reg & 0x80) ? "SPI" : "I2C");
	printk("Address: 0x%02X%02X\n", retained->imu_addr, retained->imu_reg);

#if SENSOR_MAG_EXISTS
	printk("\nMagnetometer: %s\n", (retained->mag_addr & 0x7F) != 0x7F ? sensor_get_sensor_mag_name() : "Not searching");
	if (retained->mag_reg != 0xFF)
		printk("Interface: %s%s\n", (retained->mag_reg & 0x80) ? "SPI" : "I2C", (retained->mag_addr & 0x80) ? ", external" : "");
	printk("Address: 0x%02X%02X\n", retained->mag_addr, retained->mag_reg);
#endif

	if (CONFIG_1_SETTINGS_READ(CONFIG_1_SENSOR_USE_6_SIDE_CALIBRATION))
	{
		printk("\nAccelerometer matrix:\n");
		for (int i = 0; i < 3; i++)
			printk("%.5f %.5f %.5f %.5f\n", (double)retained->accBAinv[0][i], (double)retained->accBAinv[1][i], (double)retained->accBAinv[2][i], (double)retained->accBAinv[3][i]);
	}
	else
	{
		printk("\nAccelerometer bias: %.5f %.5f %.5f\n", (double)retained->accelBias[0], (double)retained->accelBias[1], (double)retained->accelBias[2]);
	}
	printk("Gyroscope bias: %.5f %.5f %.5f\n", (double)retained->gyroBias[0], (double)retained->gyroBias[1], (double)retained->gyroBias[2]);
#if SENSOR_MAG_EXISTS
//	printk("Magnetometer bridge offset: %.5f %.5f %.5f\n", (double)retained->magBias[0], (double)retained->magBias[1], (double)retained->magBias[2]);
	printk("Magnetometer matrix:\n");
	for (int i = 0; i < 3; i++)
		printk("%.5f %.5f %.5f %.5f\n", (double)retained->magBAinv[0][i], (double)retained->magBAinv[1][i], (double)retained->magBAinv[2][i], (double)retained->magBAinv[3][i]);
#endif

	printk("\nFusion: %s\n", sensor_get_sensor_fusion_name());
}

static void print_connection(void)
{
	bool paired = retained->paired_addr[0];
	printk(paired ? "Tracker ID: %u\n" : "Tracker ID: None\n", retained->paired_addr[1]);
	printk("Device address: %012llX\n", *(uint64_t *)NRF_FICR->DEVICEADDR & 0xFFFFFFFFFFFF);
	printk(paired ? "Receiver address: %012llX\n" : "Receiver address: None\n", (*(uint64_t *)&retained->paired_addr[0] >> 16) & 0xFFFFFFFFFFFF);
}

static void print_battery(void)
{
	int battery_mV = sys_get_valid_battery_mV();
	int16_t calibrated_pptt = sys_get_calibrated_battery_pptt(sys_get_valid_battery_pptt());
	uint64_t unplugged_time = sys_get_last_unplugged_time();
	uint64_t remaining = sys_get_battery_remaining_time_estimate();
	uint64_t runtime = sys_get_battery_runtime_estimate();
	if (battery_mV > 0)
	{
		unplugged_time = k_ticks_to_us_floor64(k_uptime_ticks() - unplugged_time);
		uint32_t hours = unplugged_time / 3600000000;
		unplugged_time %= 3600000000;
		uint8_t minutes = unplugged_time / 60000000;
		if (hours > 0 || minutes > 0)
			printk("Battery: %.0f%% (Read %uh %umin ago)\n", (double)calibrated_pptt / 100.0, hours, minutes);
		else
			printk("Battery: %.0f%%\n", (double)calibrated_pptt / 100.0);
	}
	else if (unplugged_time == 0)
	{
		printk("Battery: Waiting for valid reading\n");
	}
	else
	{
		printk("Battery: None\n");
	}
	if (remaining > 0)
	{
		remaining = k_ticks_to_us_floor64(remaining);
		uint32_t hours = remaining / 3600000000;
		remaining %= 3600000000;
		uint8_t minutes = remaining / 60000000;
		printk("Remaining runtime: %uh %umin\n", hours, minutes);
	}
	else
	{
		printk("Remaining runtime: Not available\n");
	}
	if (runtime > 0)
	{
		runtime = k_ticks_to_us_floor64(runtime);
		uint32_t hours = runtime / 3600000000;
		runtime %= 3600000000;
		uint8_t minutes = runtime / 60000000;
		printk("Fully charged runtime: %uh %umin\n", hours, minutes);
	}
	else
	{
		printk("Fully charged runtime: Not available\n");
	}
}

static void print_info(void)
{
	print_board();
	printk("\n");
	print_sensor();
	printk("\n");
	print_connection();
	printk("\n");
	print_battery();
}

static void print_uptime(const uint64_t ticks, const char *name)
{
	uint64_t uptime = k_ticks_to_us_floor64(ticks);

	uint32_t hours = uptime / 3600000000;
	uptime %= 3600000000;
	uint8_t minutes = uptime / 60000000;
	uptime %= 60000000;
	uint8_t seconds = uptime / 1000000;
	uptime %= 1000000;
	uint16_t milliseconds = uptime / 1000;
	uint16_t microseconds = uptime % 1000;

	printk("%s: %02u:%02u:%02u.%03u,%03u\n", name, hours, minutes, seconds, milliseconds, microseconds);
}

static void print_battery_tracker(void)
{
	int adc_mV = sys_get_battery_mV();
	printk("ADC: %d mV\n", adc_mV);

	int battery_mV = sys_get_valid_battery_mV();
	int16_t pptt = sys_get_valid_battery_pptt();
	int16_t calibrated_pptt = sys_get_calibrated_battery_pptt(pptt);
	uint64_t unplugged_time = sys_get_last_unplugged_time();
	if (battery_mV > 0)
		printk("\nBattery: %.2f%% (Raw %.2f%%, %d mV)\n", (double)calibrated_pptt / 100.0, (double)pptt / 100.0, battery_mV);
	else
		printk("\nBattery: None\n");
	if (unplugged_time > 0)
		print_uptime(k_uptime_ticks() - unplugged_time, "Last updated");
	else
		printk("Last updated: Never\n");

	uint64_t runtime = sys_get_battery_runtime_estimate();
	uint64_t runtime_min = sys_get_battery_runtime_min_estimate();
	uint64_t runtime_max = sys_get_battery_runtime_max_estimate();
	uint64_t remaining = sys_get_battery_remaining_time_estimate();
	if (remaining > 0)
		print_uptime(remaining, "\nRemaining runtime");
	else
		printk("Remaining runtime: Not available\n");
	if (runtime > 0)
		print_uptime(runtime, "Fully charged runtime");
	else
		printk("Fully charged runtime: Not available\n");
	if (runtime_min > 0)
		print_uptime(runtime_min, "Minimum runtime");
	else
		printk("Minimum runtime: Not available\n");
	if (runtime_max > 0)
		print_uptime(runtime_max, "Maximum runtime");
	else
		printk("Maximum runtime: Not available\n");

	int16_t last_min = sys_get_last_cycle_min_pptt();
	int16_t last_max = sys_get_last_cycle_max_pptt();
	int16_t last_calibrated_min = sys_get_calibrated_battery_pptt(last_min);
	int16_t last_calibrated_max = sys_get_calibrated_battery_pptt(last_max);
	uint64_t last_runtime = sys_get_last_cycle_runtime();
	if (last_min >= 0 && last_max >= 0 && last_runtime > 0)
	{
		printk("\nLast discharge cycle: %.2f%% -> %.2f%% (Raw %.2f%% -> %.2f%%)\n", (double)last_calibrated_max / 100.0, (double)last_calibrated_min / 100.0, (double)last_max / 100.0, (double)last_min / 100.0);
		print_uptime(last_runtime, "Last cycle runtime");
	}
	else
	{
		printk("\nLast cycle: Not available\n");
	}

	uint8_t coverage = sys_get_battery_calibration_coverage() * 5;
	int16_t min = sys_get_calibrated_battery_range_min_pptt();
	int16_t max = sys_get_calibrated_battery_range_max_pptt();
	if (min >= 0 && max >= 0)
		printk("\nCalibration: %.0f%% - %.0f%% (%.0f%% coverage)\n", (double)min / 100.0, (double)max / 100.0, (double)coverage);
	else
		printk("\nCalibration: None\n");
	printk("Cycle count: ~%.2f\n", (double)sys_get_battery_cycles() / 20.0);
}

static void print_meow(void)
{
	int64_t ticks = k_uptime_ticks();

	ticks %= ARRAY_SIZE(meows) * ARRAY_SIZE(meow_punctuations) * ARRAY_SIZE(meow_suffixes) * ARRAY_SIZE(meow_colors); // silly number generator
	uint8_t meow = ticks / (ARRAY_SIZE(meow_punctuations) * ARRAY_SIZE(meow_suffixes) * ARRAY_SIZE(meow_colors));
	ticks %= ARRAY_SIZE(meow_punctuations) * ARRAY_SIZE(meow_suffixes) * ARRAY_SIZE(meow_colors);
	uint8_t punctuation = ticks / (ARRAY_SIZE(meow_suffixes) * ARRAY_SIZE(meow_colors));
	ticks %= ARRAY_SIZE(meow_suffixes) * ARRAY_SIZE(meow_colors);
	uint8_t suffix = ticks / ARRAY_SIZE(meow_suffixes);
	uint8_t color = ticks % ARRAY_SIZE(meow_colors);

	printk("\033[38;5;%d;1m%s%s\033[0;38;2;255;255;255m%s\033[0m\n", meow_colors[color], meows[meow], meow_punctuations[punctuation], meow_suffixes[suffix]);
}

static int32_t parse_config_settings_id(char *s)
{
	int32_t id = parse_i32(s, 10);
	uint8_t buf[12];
	snprintk(buf, 12, "%d", id);
	if (strcmp(buf, s) != 0)
		return -1;
	return id;
}

static int parse_config_settings_write(char *s, int32_t v)
{
	int32_t id = parse_config_settings_id(s);
	uint16_t k = 0;
	int err = -1;
	for (int i = 0; i < CONFIG_SETTINGS_COUNT; i++)
	{
		for (int j = 0; j < config_settings_count[i]; j++)
		{
			if (id < 0 ? strcmp(s, config_settings_names[k]) == 0 : id == k)
			{
				switch (i)
				{
				case 0:
					if (v < 0 || v > 1)
						break;
					config_0_settings_write(j, v);
					err = 0;
					break;
				case 1:
					if (v < 0 || v > 1)
						break;
					config_1_settings_write(j, v);
					err = 0;
					break;
				case 2:
					if (v < INT16_MIN || v > INT16_MAX)
						break;
					config_2_settings_write(j, v);
					err = 0;
					break;
				case 3:
					config_3_settings_write(j, v);
					err = 0;
					break;
				default:
					break;
				}
				if (!err)
					printk("Updated config: %s=%d\n", config_settings_names[k], v);
				else
					printk("Invalid value\n");
				return err;
			}
			k++;
		}
	}
	printk("Invalid config name or id\n");
	return -1;
}

static void parse_config_settings_read(char *s)
{
	int32_t id = parse_config_settings_id(s);
	uint16_t k = 0;
	for (int i = 0; i < CONFIG_SETTINGS_COUNT; i++)
	{
		for (int j = 0; j < config_settings_count[i]; j++)
		{
			if (id < 0 ? strcmp(s, config_settings_names[k]) == 0 : id == k)
			{
				int32_t val = -1;
				switch (i)
				{
				case 0:
					val = CONFIG_0_SETTINGS_READ(j) ? 1 : 0;
					break;
				case 1:
					val = CONFIG_1_SETTINGS_READ(j) ? 1 : 0;
					break;
				case 2:
					val = CONFIG_2_SETTINGS_READ(j);
					break;
				case 3:
					val = CONFIG_3_SETTINGS_READ(j);
					break;
				default:
					break;
				}
				printk("Read config: %s=%d\n", config_settings_names[k], val);
				return;
			}
			k++;
		}
	}
	printk("Invalid config name or id\n");
}

static void parse_config_settings_read_all()
{
	uint16_t k = 0;
	for (int i = 0; i < CONFIG_SETTINGS_COUNT; i++)
	{
		for (int j = 0; j < config_settings_count[i]; j++)
		{
			int32_t val = -1;
			switch (i)
			{
			case 0:
				val = CONFIG_0_SETTINGS_READ(j) ? 1 : 0;
				break;
			case 1:
				val = CONFIG_1_SETTINGS_READ(j) ? 1 : 0;
				break;
			case 2:
				val = CONFIG_2_SETTINGS_READ(j);
				break;
			case 3:
				val = CONFIG_3_SETTINGS_READ(j);
				break;
			default:
				break;
			}
			printk("Read config: %s=%d\n", config_settings_names[k], val);
			k++;
		}
	}
}

static int parse_config_settings_reset(char *s)
{
	int32_t id = parse_config_settings_id(s);
	uint16_t k = 0;
	for (int i = 0; i < CONFIG_SETTINGS_COUNT; i++)
	{
		for (int j = 0; j < config_settings_count[i]; j++)
		{
			if (id < 0 ? strcmp(s, config_settings_names[k]) == 0 : id == k)
			{
				config_settings_reset(i, j);
				return 0;
			}
			k++;
		}
	}
	printk("Invalid config name or id\n");
	return -1;
}

static inline void strtolower(char *str)
{
	for (int i = 0; str[i]; i++)
		str[i] = tolower(str[i]);
}

static void print_help(void)
{
	printk("\nhelp                         Display this help text\n");

	printk("\ninfo                         Get device information\n");
	printk("uptime                       Get device uptime\n");
	printk("reboot                       Soft reset the device\n");
	printk("battery                      Get battery information\n");
	printk("stats                        Get radio packet counts since the last stats\n");
	printk("pairs                        Timestamp pairs from the receiver and their line fit\n");
	printk("pulse [on|off|width|at|trim] The frame-boundary LED pulse on D5-D8 (width up to 215 us)\n");
	printk("hold <ms>                    Ignore the receiver's timestamps (holdover test)\n");
	printk("imu [zero]                   IMU sample timing and half-frame slices\n");
	printk("markers [<D5..D8 ids>]       Marker IDs for the roll call (1-30), one per pin\n");
	printk("airtime [b <n> [<ms>]]       Radio time per packet; b sends n test packets B\n");
	printk("\nscan                         Restart sensor scan\n");
	printk("calibrate                    Calibrate sensor ZRO\n");
	printk("6-side                       Calibrate 6-side accelerometer\n");
#if SENSOR_MAG_EXISTS
	printk("mag                          Clear magnetometer calibration\n");
#endif
	printk("\nset <address>                Manually set receiver\n");
	printk("pair                         Enter pairing mode\n");
	printk("clear                        Clear pairing data\n");
#if DFU_EXISTS
	printk("\ndfu                          Enter DFU bootloader\n");
#endif
	printk("\nmeow                         Meow!\n");

#if SENSOR_MAG_EXISTS
	printk("\nreset_data (zro|acc|mag|bat|all)\n");
#else
	printk("\nreset_data (zro|acc|bat|all)\n");
#endif

	printk("\nlist_config                  Display available settings\n");
	printk("write_config (base64|<config name>|<config id>) <value>\n");
	printk("read_config (all|base64|<config name>|<config id>)\n");
	printk("reset_config (all|<config name>|<config id>)\n");
}

static void console_thread(void)
{
#if USB_EXISTS && DFU_EXISTS
	if (button_read()) // button held on usb connect, enter DFU
	{
#if ADAFRUIT_BOOTLOADER
		NRF_POWER->GPREGRET = 0x57;
		sys_request_system_reboot(false);
#endif
#if NRF5_BOOTLOADER
		gpio_pin_configure(gpio_dev, 19, GPIO_OUTPUT | GPIO_OUTPUT_INIT_LOW);
#endif
	}
#endif

#if USB_EXISTS
	console_getline_init();
	// riftcv1-band: wait at most 0.5 s for the log to drain: input arriving meanwhile fills the USB
	// buffers, the driver logs an error on every retry and the log never drained, so the console
	// never started
	int64_t log_wait_end = k_uptime_get() + 500;
	while (log_data_pending() && k_uptime_get() < log_wait_end)
		k_usleep(1);
	k_msleep(100);
	printk("*** " CONFIG_USB_DEVICE_MANUFACTURER " " CONFIG_USB_DEVICE_PRODUCT " ***\n");
#endif
	printk(FW_STRING);
	print_help();

	const char command_help[] = "help";

	const char command_info[] = "info";
	const char command_uptime[] = "uptime";
	const char command_reboot[] = "reboot";
	const char command_battery[] = "battery";
	const char command_stats[] = "stats";
	const char command_pairs[] = "pairs";
	const char command_pulse[] = "pulse";
	const char command_hold[] = "hold";
	const char command_imu[] = "imu";
	const char command_markers[] = "markers";
	const char command_airtime[] = "airtime";
	const char command_scan[] = "scan";
	const char command_calibrate[] = "calibrate";
	const char command_6_side[] = "6-side";
#if SENSOR_MAG_EXISTS
	const char command_mag[] = "mag";
#endif
	const char command_set[] = "set";
	const char command_pair[] = "pair";
	const char command_clear[] = "clear";
#if DFU_EXISTS
	const char command_dfu[] = "dfu";
#endif
	const char command_meow[] = "meow";

	// data
	const char command_reset_data[] = "reset_data";
	const char command_reset_arg_zro[] = "zro";
	const char command_reset_arg_acc[] = "acc";
#if SENSOR_MAG_EXISTS
	const char command_reset_arg_mag[] = "mag";
#endif
	const char command_reset_arg_bat[] = "bat";
	const char command_reset_arg_all[] = "all";

	// settings
	const char command_list_config[] = "list_config";
	const char command_write_config[] = "write_config";
	const char command_read_config[] = "read_config";
	const char command_reset_config[] = "reset_config";
	const char command_wr_arg_all[] = "all";
	const char command_wr_arg_base64[] = "base64";

	// debug
	const char command_nvs[] = "nvs";

	while (1) {
#if USB_EXISTS
		char *line = console_getline();
#else
		char *line = rtt_console_getline();
#endif
		char* argv[5] = {NULL}; // command and 4 args
		size_t argc = parse_args(line, argv, ARRAY_SIZE(argv));
		if(argc == 0)
			continue;
		if(argc > 0)
			strtolower(argv[0]); // lower case the command
		if(argc > 1)
			strtolower(argv[1]); // lower case the first argument
		// only care that the first words are matchable

		if (strcmp(argv[0], command_help) == 0)
		{
			print_help();
		}
		else if (strcmp(argv[0], command_info) == 0)
		{
			print_info();
		}
		else if (strcmp(argv[0], command_uptime) == 0)
		{
			uint64_t uptime = k_uptime_ticks();
			print_uptime(uptime, "Uptime");
			print_uptime(uptime - retained->uptime_latest + retained->uptime_sum, "Accumulated");
		}
		else if (strcmp(argv[0], command_reboot) == 0)
		{
			sys_request_system_reboot(false);
		}
		else if (strcmp(argv[0], command_battery) == 0)
		{
			print_battery_tracker();
		}
		else if (strcmp(argv[0], command_stats) == 0)
		{
			esb_print_stats();
		}
		else if (strcmp(argv[0], command_pairs) == 0)
		{
			rift_ts_print();
		}
		else if (strcmp(argv[0], command_pulse) == 0)
		{
			rift_pulse_command(argc, argv);
		}
		else if (strcmp(argv[0], command_hold) == 0)
		{
			rift_pulse_hold_command(argc, argv);
		}
		else if (strcmp(argv[0], command_imu) == 0)
		{
			rift_imu_command(argc, argv);
		}
		else if (strcmp(argv[0], command_markers) == 0)
		{
			rift_pulse_markers_command(argc, argv);
		}
		else if (strcmp(argv[0], command_airtime) == 0)
		{
			rift_airtime_command(argc, argv);
		}
		else if (strcmp(argv[0], command_scan) == 0)
		{
			sensor_request_scan(true);
		}
		else if (strcmp(argv[0], command_calibrate) == 0)
		{
			sensor_request_calibration();
		}
		else if (strcmp(argv[0], command_6_side) == 0)
		{
			sensor_request_calibration_6_side();
		}
#if SENSOR_MAG_EXISTS
		else if (strcmp(argv[0], command_mag) == 0)
		{
			sensor_calibration_clear_mag(NULL, true);
		}
#endif
		else if (strcmp(argv[0], command_set) == 0)
		{
			if (argc != 2)
			{
				printk("Invalid number of arguments\n");
				continue;
			}
			uint64_t addr = parse_u64(argv[1], 16);
			uint8_t buf[17];
			snprintk(buf, 17, "%016llx", addr);
			if (addr != 0 && strcmp(buf, argv[1]) == 0)
				esb_set_pair(addr);
			else
				printk("Invalid address\n");
		}
		else if (strcmp(argv[0], command_pair) == 0)
		{
			esb_reset_pair();
		}
		else if (strcmp(argv[0], command_clear) == 0)
		{
			esb_clear_pair();
		}
#if DFU_EXISTS
		else if (strcmp(argv[0], command_dfu) == 0)
		{
#if ADAFRUIT_BOOTLOADER
			NRF_POWER->GPREGRET = 0x57;
			sys_request_system_reboot(false);
#endif
#if NRF5_BOOTLOADER
			gpio_pin_configure(gpio_dev, 19, GPIO_OUTPUT | GPIO_OUTPUT_INIT_LOW);
#endif
		}
#endif
		else if (strcmp(argv[0], command_meow) == 0)
		{
			print_meow();
		}
		else if (strcmp(argv[0], command_reset_data) == 0)
		{
			if (argc != 2)
				printk("Invalid number of arguments\n");
			else if (strcmp(argv[1], command_reset_arg_zro) == 0)
				sensor_calibration_clear(NULL, NULL, true);
			else if (strcmp(argv[1], command_reset_arg_acc) == 0)
				sensor_calibration_clear_6_side(NULL, true);
#if SENSOR_MAG_EXISTS
			else if (strcmp(argv[1], command_reset_arg_mag) == 0)
				sensor_calibration_clear_mag(NULL, true);
#endif
			else if (strcmp(argv[1], command_reset_arg_bat) == 0)
				sys_reset_battery_tracker();
			else if (strcmp(argv[1], command_reset_arg_all) == 0)
				sys_clear();
			else
				printk("Invalid argument\n");
		}
		else if (strcmp(line, command_list_config) == 0)
		{
			uint16_t k = 0;
			for (int i = 0; i < CONFIG_SETTINGS_COUNT; i++)
			{
				printk("Config %d:\n", i);
				for (int j = 0; j < config_settings_count[i]; j++)
				{
					printk("%u: %s\n", k, config_settings_names[k]);
					k++;
				}
			}
		}
		else if (strcmp(argv[0], command_write_config) == 0)
		{
			if (argc != 3)
			{
				printk("Invalid number of arguments\n");
			}
			else if (strcmp(argv[1], command_wr_arg_base64) == 0)
			{
				uint8_t *tmp = k_malloc(128);
				uint16_t len = 0;
				int err = base64_decode(tmp, 128, (size_t *)&len, argv[2], 172);
				if (err)
				{
					printk("Unable to decode input");
					continue;
				}
				//printk("decode: %d, len %d\n", err, len);
				memcpy(retained->settings, tmp, sizeof(retained->settings));
				config_settings_init(); // reset any non-overridden values
				sys_write(SETTINGS_ID, NULL, retained->settings, sizeof(retained->settings));
				k_free(tmp);
				printk("Updated config\n");
			}
			else
			{
				int32_t val = parse_i32(argv[2], 10);
				parse_config_settings_write(argv[1], val);
			}
		}
		else if (strcmp(line, command_read_config) == 0)
		{
			if (argc != 2)
			{
				printk("Invalid number of arguments\n");
			}
			else if (strcmp(argv[1], command_wr_arg_all) == 0)
			{
				parse_config_settings_read_all();
			}
			else if (strcmp(argv[1], command_wr_arg_base64) == 0)
			{
				uint8_t *tmp = k_malloc(173);
				uint16_t len = 0;
				base64_encode(tmp, 173, (size_t *)&len, retained->settings, 128);
				//printk("encode: %d, len %d\n", err, len);
				printk("%s\n", tmp);
				k_free(tmp);
			}
			else
			{
				parse_config_settings_read(argv[1]);
			}
		}
		else if (strcmp(line, command_reset_config) == 0)
		{
			if (argc != 2)
			{
				printk("Invalid number of arguments\n");
			}
			else if (strcmp(argv[1], command_wr_arg_all) == 0)
			{
				config_settings_reset_all();
			}
			else
			{
				if (!parse_config_settings_reset(argv[1]))
					printk("Reset config: %s\n", argv[1]);
			}
		}
		else if (strcmp(line, command_nvs) == 0)
		{
			sys_nvs_stats();
		}
		else
		{
			printk("Unknown command\n");
		}
	}
}

#endif
```
